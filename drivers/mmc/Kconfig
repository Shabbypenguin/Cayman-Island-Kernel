## drivers/mmc/Kconfig
```kconfig
#
# MMC subsystem configuration
#

menuconfig MMC
	tristate "MMC/SD/SDIO card support"
	depends on HAS_IOMEM
	help
	  This selects MultiMediaCard, Secure Digital and Secure
	  Digital I/O support.

	  If you want MMC/SD/SDIO support, you should say Y here and
	  also to your specific host controller driver.

config MMC_DEBUG
	bool "MMC debugging"
	depends on MMC != n
	help
	  This is an option for use by developers; most people should
	  say N here.  This enables MMC core and driver debugging.

config MMC_PERF_PROFILING
	bool "MMC performance profiling"
	depends on MMC != n
	default n
	help
	  If you say Y here, support will be added for collecting
	  performance numbers at the MMC Queue and Host layers.

config LGE_MMC_WORKAROUND
	bool "MMC work-around codes"
	depends on MACH_LGE_I_BOARD
	default n
	help
	  This enables LGE MMC work-around codes to make stable

config LGE_REMOVE_ERROR
	bool "LGE_REMOVE_ERROR"
	depends on MACH_LGE_I_BOARD
	default n
	help
	  This enables LGE_REMOVE_ERROR codes to Detect MSM_SDCC status


if MMC

source "drivers/mmc/core/Kconfig"

source "drivers/mmc/card/Kconfig"

source "drivers/mmc/host/Kconfig"

endif # MMC
```

## lge/Kconfig
```kconfig
#platform.team@lge.com	2011.01

menu "LGE platform selection"

menu "LGE Board selection"
source "lge/lge_board/Kconfig"
endmenu

menu "LGE Device selection"
source "lge/com_device/Kconfig"
endmenu

menu "LGE Factory Feature"
source "lge/factory/Kconfig"
endmenu

menu "LGE Development Feature"
source "lge/debug/Kconfig"
endmenu

menu "LGE ETA Feature"
source "lge/eta/Kconfig"
endmenu

endmenu
```

## lge/com_device/Kconfig
```kconfig
#platform.team@lge.com	2011.01

config LGE_MACH_BOARD_REVA
	depends on ARCH_MSM8X60
	default n
	bool "BOARD_REVA"
	help
		LGE MSM8660 RevA Board Configuration

config LGE_MACH_BOARD_REVB
	depends on ARCH_MSM8X60
	default y
	bool "BOARD_REVB"
	help
		LGE MSM8660 RevB Board Configuration

config LGE_MACH_BOARD_REVC
	depends on ARCH_MSM8X60
	default n
	bool "BOARD_REVC"
	help
		LGE MSM8660 RevC Board Configuration


menu "Audio"
source "lge/com_device/audio/Kconfig"
endmenu 

menu "Camera"
source "lge/com_device/camera/Kconfig"
endmenu

menu "Display"
source "lge/com_device/display/Kconfig"
endmenu 

menu "Input"
source "lge/com_device/input/Kconfig"
endmenu

menu "Misc."
source "lge/com_device/misc/Kconfig"
endmenu

menu "Power"
source "lge/com_device/power/Kconfig"
endmenu

menu "MHL V1"
source "lge/com_device/mhl_v1/Kconfig"
endmenu
```

## lge/com_device/audio/Kconfig
```kconfig
#platform.team@lge.com	2011.01

config LGE_AUDIO
	default y
	bool "LGE Audio Configuration"
	help
		LGE AUDIO Configuration

# Audio driver configuration
comment "Audio driver Selection"

config LGE_AUDIO_AMP_WM9093
        bool "Audio subsystem WM9093"
        default y
        ---help---
                Wolfson microelectronics Ultra Low power Audio subsystem
```

## lge/com_device/camera/Kconfig
```kconfig
#platform.team@lge.com	2011.01

config LGE_CAMERA
	default y
	bool "LGE Camera Configuration"
	help
		LGE CAMERA Configuration


# Camera driver configuration
comment "Camera Sensor Selection"

config LGE_SENSOR_IMX105
	bool "Sensor IMX105 8MP MIPI (BAYER 8M)"
	depends on MSM_CAMERA && ARCH_MSM8X60
	default n
	---help---
	SONY 8M Bayer MIPI Sensor with Autofocus

config LGE_SENSOR_MT9P017
	bool "Sensor MT9P017 5MP MIPI (BAYER 5M)"
	depends on MSM_CAMERA && ARCH_MSM8X60
	default y
	---help---
	APTINA 5M Bayer MIPI Sensor with Autofocus

config LGE_SENSOR_MT9V113
	bool "Sensor MT9V113 VGA MIPI (SOC 0.3M)"
	depends on MSM_CAMERA && ARCH_MSM8X60
	default y
	---help---
	APTINA 0.3M SOC MIPI Sensor

config LGE_SENSOR_ISX005
	bool "Sensor isx005 (YUV 3M)"
	#depends on MSM_CAMERA && !ARCH_MSM8X60
	default n
	---help---
	  SONY 3M YUV Sensor with AutoFocus
	  
config LGE_SENSOR_ISX006
	bool "Sensor isx006 (YUV 5M)"
	#depends on MSM_CAMERA && !ARCH_MSM8X60
	default n
	---help---
	  SONY 5M Sensor with AutoFocus
	
config LGE_SENSOR_MT9M113
	bool "Sensor mt9m113 (YUV 1.3M)"
	#depends on MSM_CAMERA && !ARCH_MSM8X60
	default n
	---help---
	  APTINA 1.3M Sensor

config LGE_SENSOR_MT9M114
	bool "Sensor MT9M114 1.26MP MIPI (SOC 1.26M)"
	depends on MSM_CAMERA && ARCH_MSM8X60
	default n
	---help---
	APTINA 1.26M SOC MIPI Sensor without Autofocus	

config VTCAM_SD_IMAGE_TUNNING
	bool "SD Card Image Tuning for MT9M114"
	depends on LGE_SENSOR_MT9M114
	default n
	---help---
	SD Card Image Tuning for MT9M114

config VTCAM_SD_IMAGE_TUNNING_FOR_MT9V113
	bool "SD Card Image Tuning for MT9V113"
	depends on LGE_SENSOR_MT9V113
	default y
	---help---
	SD Card Image Tuning for MT9V113

comment "Camera flash Selection"
	  	  
config LGE_FLASH_AAT1270
	bool "AAT1270 flash support"
	#depends on MSM_CAMERA && !ARCH_MSM8X60
	default n
	---help---
	  Enable support for AAT1270 flash for msm camera

config LGE_FLASH_LM3559
	bool "LM3559 flash support"
	#depends on MSM_CAMERA && ARCH_MSM8X60
	default y
	---help---
	  Enable support for LM3559 flash for msm camera


comment "Camera Power Selection"

config LGE_PM_BH6172
	bool "BH6172 pm support"
	#depends on MSM_CAMERA && !ARCH_MSM8X60
	default n
	---help---
	  SUBPMIC for camera sensor
```

## lge/com_device/display/Kconfig
```kconfig
#platform.team@lge.com	2011.01

menu "Device Drivers"

comment "LGE display driver selection"

config LGE_BACKLIGHT_AAT2862
	bool "select aat2862 device as LGE backlight management for I "
	default n
	---help---
	LGE backlight management (aat2862)

config LGE_BACKLIGHT_LM3530
	bool "select lm3530 device as LGE backlight management for I "
	default y
	---help---
	LGE backlight management (lm3530)

config LGE_BACKLIGHT_LM3537
	bool "select lm3537 device as LGE backlight management for Cayman "
	default y
	---help---
	LGE backlight management (lm3537)

choice
	prompt "LGE Display Selection"
	default LGE_DISPLAY_MIPI_LGIT_VIDEO_HD_PT 

config LGE_DISPLAY_MIPI_SHARP_VIDEO_WVGA_PT
	bool "LGE_DISPLAY_MIPI_SHARP_VIDEO_WVGA_PT"
	select FB_MSM_MIPI_DSI
	---help---
	LGE display management 

config LGE_DISPLAY_MIPI_LGIT_VIDEO_HD_PT
	bool "LGE_DISPLAY_MIPI_LGIT_VIDEO_HD_PT"
	select FB_MSM_MIPI_DSI
	---help---
	LGE display management 

config LGE_DISPLAY_MIPI_LGD_VIDEO_WVGA_PT
	bool "LGE_DISPLAY_MIPI_LGD_VIDEO_WVGA_PT"
	select FB_MSM_MIPI_DSI
	---help---
	LGE display management 

config LGE_DISPLAY_MIPI_LGD_CMD_WVGA_PT
	bool "LGE_DISPLAY_MIPI_LGD_CMD_WVGA_PT"
	select FB_MSM_MIPI_DSI
	---help---
	LGE display management 
endchoice

endmenu
menu "Features"

config LGE_I_DISP_FBREAD
	bool "enable msm_fb_read"
	default y
	---help---
	select this feature if you want to dump framebuffer

config LGE_I_DISP_EARLYSUSPEND
	bool "enable LCD early suspend"
	default y
	---help---
	select this feature if you want to enable LCD early suspend

config LGE_I_DISP_UNDERRUN
	bool "prevent under-run during video play"
	default y
	---help---
	select this feature for preventing under-run issue

config LGE_I_DISP_PHYSIZE
	bool "hard-coding for LCD physical size"
	default y
	---help---
	select this feature for fb_info.var.width=56, fb_info.var.height=99

config LGE_I_DISP_HSMODE
	bool "MIPI clk High Speed mode"
	default y
	---help---
	select this feature for HM mode MIPI clock

config LGE_BOOTLOADER_DISP_INIT
	bool "LGE Bootloader Display support"
	default y
	---help---
	select this feature for LGE Bootloader Display support

config LGE_KEY_BACKLIGHT_ALC
	bool "LGE_KEY_BACKLIGHT_ALC"
	default y
	---help---
	select this feature for key backlight off when lux value is over 100
endmenu
```

## lge/com_device/input/Kconfig
```kconfig
#platform.team@lge.com	2011.01
#
# Input driver configuration
#


# Sensor driver configuration
comment "Sensor driver Selection"
config LGE_SENSOR
	default y
	bool "LGE Sensor Devices Common Configuration"
	help
		LGE Sensor Devices Common Configuration

config LGE_SENSOR_FUSION
	default y
	bool "LGE Sensor Fusion Configuration"
	help
		LGE Sensor Fusion Configuration

config LGE_SENSOR_ACCELEROMETER
	default y
	bool "LGE Accelerometer STM K3DH Configuration"
	help
		LGE Accelerometer STM K3DH Configuration
		
config LGE_SENSOR_GYROSCOPE
	default y
	bool "LGE Gyroscope STM K3GTR Configuration"
	help
		LGE Gyroscope STM K3GTR Configuration		
		
config LGE_SENSOR_DCOMPASS
	default y
	bool "LGE Digital Compass AICHI AMI306 Configuration"
	help
		LGE Digital Compass  AICHI AMI306 Configuration		

config LGE_SENSOR_PROXIMITY
	tristate "APDS9900 based proximity and light sensor"
	help
	  Say Y here if you have a sensor interface using the
	  APDS9900 controller, and your board-specific
	  setup code includes i2c devices.

	  If unsure, say N (but it's safe to say "Y").
config LGE_SENSOR_GP2AP
	tristate "GP2AP based proximity sensor"
	help
	  Say Y here if you have a sensor interface using the
	  GP2AP controller, and your board-specific
	  setup code includes i2c devices.

	  If unsure, say N (but it's safe to say "Y").

	  To compile this driver as a module, choose M here: the
	  module will be called ads7846.

config LGE_SENSOR_KR3DH
	tristate "KR3DH based accelerometer sensor"
	help
	  Say Y here if you have a sensor interface using the
	  KR3DH controller, and your board-specific
	  setup code includes i2c devices.

	  If unsure, say N (but it's safe to say "Y").

	  To compile this driver as a module, choose M here: the
	  module will be called ads7846.

config LGE_SENSOR_KR3DM
	tristate "8bit accel data for KR3DM"
	help
	  Say Y here if you have a sensor interface using the
	  KR3DM controller, and your board-specific
	  setup code includes i2c devices.

	  If unsure, say N (but it's safe to say "Y").
	  
config LGE_SENSOR_AK8973
	tristate "AK8973 based ecompass sensor"
	help
	  Say Y here if you have a sensor interface using the
	  AK8973 controller, and your board-specific
	  setup code includes i2c devices.

	  If unsure, say N (but it's safe to say "Y").

	  To compile this driver as a module, choose M here: the
	  module will be called ads7846.

config LGE_SENSOR_AMI304
        tristate "AMI304 based gyro sensor"
        help
          Say Y here if you have a sensor interface using the
          AMI304 controller, and your board-specific
          setup code includes i2c devices.

          If unsure, say N (but it's safe to say "Y").          
          
config LGE_TOUCHSCREEN_SYNAPTICS_RMI4_I2C
	tristate "Synaptics RMI4 protocol based I2C interface Touchscreen Driver"
	help
	  This enables support for Synaptics RMI4 protocol I2C interface Touchscreens.               
choice
	prompt "Register map"
	depends on LGE_TOUCHSCREEN_SYNAPTICS_RMI4_I2C

config LGE_TOUCH_REG_MAP_TM1804
	default y
	bool "TM1804"
	depends on LGE_TOUCHSCREEN_SYNAPTICS_RMI4_I2C && (LGE_MACH_BOARD_REVB || LGE_MACH_BOARD_REVC)
	help
         Register map TM1804. 

config LGE_TOUCH_REG_MAP_TM1814
	default y
	bool "TM1814"
	depends on LGE_TOUCHSCREEN_SYNAPTICS_RMI4_I2C && LGE_MACH_BOARD_REVA
	help
         Register map TM1814. 

config LGE_TOUCH_REG_MAP_TM1898_FW_VER0
	bool "TM1898_FW_VER0"
	depends on LGE_TOUCHSCREEN_SYNAPTICS_RMI4_I2C
	help
         Register map TM1898_FW_VER0. 

config LGE_TOUCH_REG_MAP_TM1898_FW_VER1
	bool "TM1898_FW_VER1"
	depends on LGE_TOUCHSCREEN_SYNAPTICS_RMI4_I2C
	help
         Register map TM1898_FW_VER1. 
         
config LGE_TOUCH_REG_MAP_TM1898_FW_VER2
	bool "TM1898_FW_VER2"
	depends on LGE_TOUCHSCREEN_SYNAPTICS_RMI4_I2C
	help
         Register map TM1898_FW_VER2. 
endchoice

config LGE_TOUCH_SYNAPTICS_FW_UPGRADE
	bool "Synaptics ClearPad General F/W upgread"
	depends on LGE_TOUCHSCREEN_SYNAPTICS_RMI4_I2C
	help
	  This enables support for Synaptics general F/W upgrade.               

config LGE_HEADSET_DETECTION_FSA8008
        tristate "Fairchild  FSA8008 headset detection"
        help
          This enables support for Fairchild  FSA8008 headset detection.

config LGE_NFC_NXP_PN544PN65N
	bool "NXP PN544 (or PN65N) I2C NFC
	default y
	help
	  This enables support for NXP PN544(or PN65N) I2C based NFC.
```

## lge/com_device/mhl_v1/Kconfig
```kconfig
#
# Copyright (c) 2011 Samsung Electronics Co., Ltd.
# 		http://www.samsung.com/
# Aakash Manik
#	aakash.manik@samsung.com

 comment "MHL driver Selection"

 config VIDEO_MHL_V1
 	depends on ARCH_MSM8X60
 	default n
 	bool "MHL"
 	help
 		This is a MHL v1 driver customized for Qualcomm MSM8660 based chipsets.
```

## lge/com_device/misc/Kconfig
```kconfig
#platform.team@lge.com	2011.01
#
# Misc strange devices for LGE platform
#
 
config LGE_TLMM_GPIO 
	depends on ARCH_MSM8X60
	default y
	bool "TLMM/GPIO Configuration"
	help
		LGE TLMM Configuration

 
config LGE_HALLIC_CARKIT 
	depends on ARCH_MSM8X60
	tristate "Hall ic car dock"
	default y
	help
	  Say Y here if you want support for the hallic car dock

# Vibrator device driver
comment "Vibrator device driver Selection"

config LGE_VIBRATOR
    bool "LGE vibrator support"
        depends on ARCH_MSM8X60
        default y
        help
          This option enables device driver support for Android Vibrator driver.
          Some functions should be given by platform data for enable PWM, Motor IC, etc.

config ANDROID_VIBRATOR
    bool "Android vibrator support"
        depends on ANDROID_TIMED_OUTPUT
        default n
        help
          This option enalbes device driver support for Android Vibrator driver.
          Some functions should be given by platform data for enable PWM, Motor IC, etc.
 
config VIB_USE_WORK_QUEUE
    bool "Vibrator use work queue"
        depends on ANDROID_VIBRATOR
        default n
        help
          This option enalbes device driver support for work queue.
 
config VIB_USE_HIGH_VOL_OVERDRIVE
    bool "Vibrator use the high voltage overdriving tech. for Q-Coin Motor"
        depends on ANDROID_VIBRATOR
        default n
        help
          This option enalbes device driver support for the high voltage overdriving tech. for Q-Coin Motor.

config LGE_MUIC_TS5USBA33402
	tristate "TSUSBA33402 MUIC driver"
	default y
	help
	  USB ID IMPEDANCE DETECTION
	  MICROUSB SWITCH TO SUPPORT USB, UART

config LGE_FOTA_MISC_INFO
	bool "Support information that is required for FOTA"
	default n 
	depends on ARCH_MSM8X60
	help
	 support SW version, MIN, etc
```
